## Kconfig.projbuild
```kconfig
menu "WIFI Configuration"
    config ESP_WIFI_ENABLED
        bool "Wifi Enabled"
        help
            Selected if Wifi is to be enabled or not. Wifi options are ignored if this option 
            is not enabled.

    if ESP_WIFI_ENABLED

        choice ESP_USE_WIFI
            prompt "Wifi Type"
            default ESP_BLUFI_ENABLED
            help
                Select which kind of Wifi configuration will be used

            config ESP_BLUFI_ENABLED
                bool "Use BluFi for WIFI config"
                help
                    Use the Espressif BluFi app to configure WIFI parameters
    
            config ESP_MANUAL_WIFI_ENABLED
                bool "Use manual config for WIFI"
                help
                    Use the compiled in parameters to configure WIFI
        endchoice

        if ESP_BLUFI_ENABLED
            config BT_ENABLED
                bool "Enable Bluetooth (REQUIRED FOR BLUFI)"
                default 1
                help
                    Enable Bluetooth in the build. Required for BluFi to work.
        endif

        config ESP_WIFI_SSID
            depends on ESP_MANUAL_WIFI_ENABLED
            string "WiFi SSID"
            help
                SSID (network name) to connect to.

        config ESP_WIFI_PASSWORD
            depends on ESP_MANUAL_WIFI_ENABLED
            string "WiFi Password"
            help
                WiFi password (WPA or WPA2) to use.

        config ESP_WIFI_SSID2_ENABLED
            bool "Enable backup/second SSID"
            depends on ESP_MANUAL_WIFI_ENABLED
            help
                Enable a second SSID to provide a backup or a second SSID for testing

        config ESP_WIFI_SSID2
            depends on ESP_WIFI_SSID2_ENABLED
            string "Second WiFi SSID"
            help
                SSID (network name) to connect to.

        config ESP_WIFI_PASSWORD2
            depends on ESP_WIFI_SSID2_ENABLED
            string "Second WiFi Password2"
            help
                WiFi password (WPA or WPA2) to use.

        config ESP_WIFI_RETRY_DELAY
            int "Delay between WIFI connect retry attempts"
            default 8
            help
                When WIFI disconnects, this is the number of seconds to wait until another retry attempt is made. This is set so not
                to hammer the WIFI routers.
                
        config ESP_WIFI_REBOOT_ENABLED
            bool "Enable Reboot on reconnect count"
            default 1

        config ESP_WIFI_REBOOT_COUNT
            int "Number of unsuccessful retries to connect before restarting the device"
            depends on ESP_WIFI_REBOOT_ENABLED
            default 25
            help
                Sometimes, the device gets stuck and will never reconnect. This is the number
                of retry attempts before the device is just rebooted.
    endif
endmenu

menu "Ethernet Configuration"
    config ESP_ETHERNET_ENABLED
        bool "Ethernet Enabled"
        help
            Selected if Ethernet is to be enabled or not. Ethernet options are ignored if this option 
            is not enabled.
            
    if ESP_ETHERNET_ENABLED
        
        choice ESP_USE_ETHERNET
            prompt "Ethernet Type"
            default ESP_USE_INTERNAL_ETHERNET if IDF_TARGET_ESP32
            default ESP_USE_DM9051 if !IDF_TARGET_ESP32
            help
                Select which kind of Ethernet will be used in the example.

            config ESP_USE_INTERNAL_ETHERNET
                depends on IDF_TARGET_ESP32
                select ETH_USE_ESP32_EMAC
                bool "Internal EMAC"
                help
                    Select internal Ethernet MAC controller. (Select for LILOGO T-Internet-POE board)

            config ESP_USE_DM9051
                bool "DM9051 Module"
                select ETH_USE_SPI_ETHERNET
                select ETH_SPI_ETHERNET_DM9051
                help
                    Select external SPI-Ethernet module (DM9051).

        endchoice

        if ESP_USE_INTERNAL_ETHERNET
            choice ESP_ETH_PHY_MODEL
                prompt "Ethernet PHY Device"
                default ESP_ETH_PHY_IP101
                help
                    Select the Ethernet PHY device to use in the example.

                config ESP_ETH_PHY_IP101
                    bool "IP101"
                    help
                        IP101 is a single port 10/100 MII/RMII/TP/Fiber Fast Ethernet Transceiver.
                        Goto http://www.icplus.com.tw/pp-IP101G.html for more information about it.

                config ESP_ETH_PHY_RTL8201
                    bool "RTL8201/SR8201"
                    help
                        RTL8201F/SR8201F is a single port 10/100Mb Ethernet Transceiver with auto MDIX.
                        Goto http://www.corechip-sz.com/productsview.asp?id=22 for more information about it.

                config ESP_ETH_PHY_LAN8720
                    bool "LAN8720"
                    help
                        LAN8720A is a small footprint RMII 10/100 Ethernet Transceiver with HP Auto-MDIX Support.
                        Goto https://www.microchip.com/LAN8720A for more information about it. For the LILYGO
                        T-Internal-POE board, see https://github.com/Xinyuan-LilyGO/LilyGO-T-ETH-POE for the correct
                        pin assignments.

                config ESP_ETH_PHY_DP83848
                    bool "DP83848"
                    help
                        DP83848 is a single port 10/100Mb/s Ethernet Physical Layer Transceiver.
                        Goto http://www.ti.com/product/DP83848J for more information about it.
            endchoice

            config ESP_ETH_MDC_GPIO
                int "SMI MDC GPIO number"
                default 23
                help
                    Set the GPIO number used by SMI MDC. (23 on LILYGO T-Internet-POE)

            config ESP_ETH_MDIO_GPIO
                int "SMI MDIO GPIO number"
                default 18
                help
                    Set the GPIO number used by SMI MDIO. (18 on LILYGO T-Internet-POE)
        endif

        if ESP_USE_DM9051
            config ESP_DM9051_SPI_HOST
                int "SPI Host Number"
                range 0 2
                default 1
                help
                    Set the SPI host used to communicate with the SPI Ethernet Controller.

            config ESP_DM9051_SCLK_GPIO
                int "SPI SCLK GPIO number"
                range 0 33
                default 19
                help
                    Set the GPIO number used by SPI SCLK.

            config ESP_DM9051_MOSI_GPIO
                int "SPI MOSI GPIO number"
                range 0 33
                default 23
                help
                    Set the GPIO number used by SPI MOSI.

            config ESP_DM9051_MISO_GPIO
                int "SPI MISO GPIO number"
                range 0 33
                default 25
                help
                    Set the GPIO number used by SPI MISO.

            config ESP_DM9051_CS_GPIO
                int "SPI CS GPIO number"
                range 0 33
                default 22
                help
                    Set the GPIO number used by SPI CS.

            config ESP_DM9051_SPI_CLOCK_MHZ
                int "SPI clock speed (MHz)"
                range 5 80
                default 20
                help
                    Set the clock speed (MHz) of SPI interface.

            config ESP_DM9051_INT_GPIO
                int "Interrupt GPIO number"
                default 4
                help
                    Set the GPIO number used by DM9051 interrupt.
        endif

        config ESP_ETH_PHY_RST_GPIO
            int "PHY Reset GPIO number"
            default 5
            help
                Set the GPIO number used to reset PHY chip.
                Set to -1 to disable PHY chip hardware reset. (5 on LILYGO T-Internet-POE)

        config ESP_ETH_PHY_ADDR
            int "PHY Address"
            range 0 31 if ESP_USE_INTERNAL_ETHERNET
            range 1 1 if !ESP_USE_INTERNAL_ETHERNET
            default 0
            help
                Set PHY address according your board schematic. (0 on LILYGO T-Internet-POE)
    endif
endmenu
```
